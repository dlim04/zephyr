## boards/shields/mikroe_adc_9_click/Kconfig.defconfig
```kconfig
# Copyright (c) 2020 Vestas Wind Systems A/S
# SPDX-License-Identifier: Apache-2.0

# TODO Check this is correct
if SHIELD_MIKROE_ADC_9_CLICK

if ADC

config ADC_INIT_PRIORITY
	default 80

endif # ADC

endif # SHIELD_MIKROE_ADC_CLICK
```

## boards/shields/mikroe_adc_9_click/Kconfig.shield
```kconfig
# Copyright (c) 2020 Vestas Wind Systems A/S
# SPDX-License-Identifier: Apache-2.0

config SHIELD_MIKROE_ADC_9_CLICK
	def_bool $(shields_list_contains,mikroe_adc_9_click)
```

## drivers/adc/Kconfig.mcp356x
```kconfig
# MCP356x ADC configuration options

# Copyright (c) 2020 Vestas Wind Systems A/S
# SPDX-License-Identifier: Apache-2.0
# TODO Check this file

config ADC_MCP356X
	bool "MCP3561/MCP3562/MCP3564 driver"
	default y
	depends on DT_HAS_MICROCHIP_MCP3561_ENABLED || DT_HAS_MICROCHIP_MCP3562_ENABLED || DT_HAS_MICROCHIP_MCP3564_ENABLED
	select SPI
	help
	  Enable MCP3564/MCP3568 ADC driver.

	  The MCP3562/MCP3562 are 4/8 channel 12-bit A/D converters
	  with SPI interface.

if ADC_MCP356X

config ADC_MCP356X_ACQUISITION_THREAD_STACK_SIZE
	int "Stack size for the ADC data acquisition thread"
	default 512
	help
	  Size of the stack used for the internal data acquisition
	  thread.

config ADC_MCP356X_ACQUISITION_THREAD_PRIO
	int "Priority for the ADC data acquisition thread"
	default 0
	help
	  Priority level for the internal ADC data acquisition thread.

endif # ADC_MCP356X
```

## dts/bindings/adc/microchip,mcp356x-base.yaml
```yaml
# Common fields for Microchip MCP3561/MCP3562/MCP3564

include: [adc-controller.yaml, spi-device.yaml]

properties:
  "#io-channel-cells":
    const: 1

io-channel-cells:
  - input
```
